## Kconfig
```kconfig
# Copyright (c) 2025 Crab Labs LLC
# SPDX-License-Identifier: Apache-2.0

menuconfig ADXL36X
	bool "ADXL36x ultralow-power 3-axis accelerometer"
	default y
	depends on DT_HAS_ADI_ADXL36X_ENABLED
	select I2C
	select GPIO
	select SENSOR
	help
	  Enable the ADXL36x accelerometer driver.
	  Supports ADXL362, ADXL363, ADXL366, and ADXL367 variants.

if ADXL36X

config ADXL36X_LOG_LEVEL
	int "ADXL36x log level"
	default 0
	range 0 4
	depends on LOG
	help
	  Sets log level for ADXL36x driver.
	  0 = OFF, 1 = ERR, 2 = WRN, 3 = INF, 4 = DBG

config ADXL36X_ODR
	int "Default output data rate (0-5)"
	range 0 5
	default 2
	help
	  Default ODR selection:
	    0 = 12.5 Hz
	    1 = 25 Hz
	    2 = 50 Hz (default)
	    3 = 100 Hz
	    4 = 200 Hz
	    5 = 400 Hz

config ADXL36X_RANGE
	int "Default measurement range (0-2)"
	range 0 2
	default 0
	help
	  Default full-scale range:
	    0 = +/- 2g (default)
	    1 = +/- 4g
	    2 = +/- 8g

config ADXL36X_IRQ_ENABLE
	bool "Enable interrupt GPIO support"
	default y
	help
	  Enable support for the INT1 pin interrupt functionality.
	  When disabled, the driver will not configure or use the INT1 GPIO
	  even if specified in devicetree.

config ADXL36X_CACHE_SIZE
	int "Internal sample cache size (XYZ triplets)"
	default 256
	range 32 512
	depends on ADXL36X_IRQ_ENABLE
	help
	  Number of XYZ sample triplets cached internally by the driver
	  when using streaming mode. The driver auto-fetches FIFO data
	  on interrupt and stores parsed samples in this cache.
	  Each sample uses 6 bytes (3x int16_t).
	  256 samples = 1536 bytes of RAM.

endif # ADXL36X
```

## dts/bindings/sensor/adi,adxl36x.yaml
```yaml
# Copyright (c) 2025 Crab Labs LLC
# SPDX-License-Identifier: Apache-2.0

description: |
  Analog Devices ADXL36x ultralow-power 3-axis accelerometer.

  Supports ADXL362, ADXL363, ADXL366, and ADXL367 variants.
  The variant property selects the chip-specific configuration
  (scale factors, available ranges, etc.).

  Uses I2C transport for communication and optional INT1 GPIO
  for hardware interrupt support (FIFO watermark, data ready,
  activity/inactivity detection).

  Example devicetree node:
    &i2c0 {
      accel: adxl366@1d {
        compatible = "adi,adxl36x";
        reg = <0x1D>;
        variant = "adxl366";
        int1-gpios = <&gpio1 10 (GPIO_ACTIVE_LOW | GPIO_PULL_UP)>;
      };
    };

compatible: "adi,adxl36x"

include: [sensor-device.yaml, i2c-device.yaml]

properties:
  variant:
    type: string
    required: true
    enum:
      - "adxl362"
      - "adxl363"
      - "adxl366"
      - "adxl367"
    description: |
      Silicon variant on the board.
        - adxl362: SPI-only, 2g/4g/8g, 270Hz max
        - adxl363: I2C/SPI, 2g/4g/8g, 400Hz max
        - adxl366: I2C/SPI, 2g/4g/8g, 400Hz max (ADXL367 pin-compatible)
        - adxl367: I2C/SPI, 2g/4g/8g, 400Hz max

  int1-gpios:
    type: phandle-array
    description: |
      Optional INT1 interrupt GPIO.
      The ADXL36x INT1 pin is configurable polarity.
      When specified, the driver supports hardware interrupt
      callbacks for FIFO watermark, data ready, and activity detection.
```
